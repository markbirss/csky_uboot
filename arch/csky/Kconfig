## arch/csky/Kconfig
```kconfig
menu "CSKY architecture"
	depends on CSKY

config SYS_ARCH
	default "csky"

config CPU_CK807_810
	bool

config CPU_CK860
	bool

config SYS_CPU
	default "ck807_810" if CPU_CK807_810
	default "ck860" if CPU_CK860

config SYS_CSKY_ARCH
	int
	default 1 if CPU_CK807_810
	default 2 if CPU_CK860

choice
	prompt "ASIC select"
	optional

config IS_ASIC
	bool "support ASIC"

endchoice

choice
	prompt "slave cpu select"
	optional

config BOOT_SLAVE_CPU
	bool "boot the slave cpu"

endchoice

choice
	prompt "Target select"
	optional

config TARGET_ERAGON
	bool "Support eragon"
	select CPU_CK807_810
	select SUPPORT_SPL

config TARGET_ERAGON_ASIC
	bool "Support eragon"
	select CPU_CK807_810
	select SUPPORT_SPL

config TARGET_KDGD
	bool "Support kdgd"
	select CPU_CK807_810
	select SUPPORT_SPL

config TARGET_ERAGON2
	bool "Support eragon2"
	select CPU_CK807_810
	select SUPPORT_SPL

config TARGET_ANOLE
	bool "Support anole"
	select CPU_CK860
	select SUPPORT_SPL

endchoice

source "board/csky/eragon_evb/Kconfig"
source "board/csky/anole_evb/Kconfig"

endmenu
```

## arch/mips/mach-loongson/Kconfig
```kconfig
menu "Microchip Loongson platforms"
	depends on MACH_LOONGSON

choice
	prompt "LOONGSON SoC select"

config SOC_ERA_LOONGSON
	bool "Microchip Loongson family"
	select SUPPORTS_LITTLE_ENDIAN
	select SUPPORTS_CPU_MIPS32_R1
	select SUPPORTS_CPU_MIPS32_R2
	select SUPPORT_SPL

endchoice

source "board/loongson/era_loongson/Kconfig"

endmenu
```

## board/csky/anole_evb/Kconfig
```kconfig
if TARGET_ANOLE

config SYS_BOARD
	default "anole_evb"

config SYS_VENDOR
	default "csky"

config SYS_SOC
	default "anole"

config SYS_CONFIG_NAME
	default "anole"

endif
```

## board/csky/byhl_evb/Kconfig
```kconfig
if TARGET_BYHL

config SYS_BOARD
	default "byhl_evb"

config SYS_VENDOR
	default "csky"

config SYS_SOC
	default "byhl"

config SYS_CONFIG_NAME
	default "byhl"

endif
```

## board/csky/eragon_evb/Kconfig
```kconfig
if TARGET_ERAGON

config SYS_BOARD
	default "eragon_evb"

config SYS_VENDOR
	default "csky"

config SYS_SOC
	default "eragon"

config SYS_CONFIG_NAME
	default "eragon"

endif

if TARGET_KDGD

config SYS_BOARD
	default "eragon_evb"

config SYS_VENDOR
	default "csky"

config SYS_SOC
	default "kdgd"

config SYS_CONFIG_NAME
	default "kdgd"

endif

if TARGET_ERAGON_LS

config SYS_BOARD
	default "eragon_evb"

config SYS_VENDOR
	default "csky"

config SYS_SOC
	default "eragon_ls"

config SYS_CONFIG_NAME
	default "eragon_ls"

endif
```

## board/loongson/era_loongson/Kconfig
```kconfig
if SOC_ERA_LOONGSON

config SYS_BOARD
	default "era_loongson"

config SYS_VENDOR
	default "loongson"

config SYS_SOC
	default "era_loongson"

config SYS_CONFIG_NAME
	default "era_loongson"

endif
```

## configs/era_loongson_defconfig
```kconfig
CONFIG_MIPS=y
CONFIG_MACH_LOONGSON=y
CONFIG_SYS_TEXT_BASE=0xb7e00000
CONFIG_CPU_MIPS32_R1=y
CONFIG_SPL=y
CONFIG_HUSH_PARSER=y
CONFIG_SYS_PROMPT="loongson # "
# CONFIG_CMD_BOOTD is not set
# CONFIG_CMD_BOOTM is not set
CONFIG_CMD_MAILBOX_SHELL=y
# CONFIG_REGEX is not set
CONFIG_UNIT_TEST=y
CONFIG_UT_TIME=y
```

## configs/eragon_defconfig
```kconfig
CONFIG_CSKY=y
CONFIG_TARGET_ERAGON=y
CONFIG_SPL=y
CONFIG_HUSH_PARSER=y
CONFIG_SYS_PROMPT="CK807 # "
# CONFIG_CMD_BDI is not set
# CONFIG_CMD_CONSOLE is not set
# CONFIG_CMD_ELF is not set
# CONFIG_CMD_IMI is not set
# CONFIG_CMD_IMLS is not set
# CONFIG_CMD_XIMG is not set
# CONFIG_CMD_EXPORTENV is not set
# CONFIG_CMD_IMPORTENV is not set
# CONFIG_CMD_EDITENV is not set
# CONFIG_CMD_ENV_EXISTS is not set
# CONFIG_CMD_CRC32 is not set
# CONFIG_CMD_LOADB is not set
# CONFIG_CMD_LOADS is not set
# CONFIG_CMD_FLASH is not set
CONFIG_CMD_MMC=y
# CONFIG_CMD_FPGA is not set
# CONFIG_CMD_ECHO is not set
# CONFIG_CMD_ITEST is not set
# CONFIG_CMD_SOURCE is not set
CONFIG_CMD_TFTPPUT=y
CONFIG_CMD_TFTPSRV=y
# CONFIG_CMD_NFS is not set
CONFIG_CMD_PING=y
# CONFIG_CMD_MISC is not set
CONFIG_NET_RANDOM_ETHADDR=y
CONFIG_NETDEVICES=y
CONFIG_ETH_DESIGNWARE=y
# CONFIG_REGEX is not set
CONFIG_UNIT_TEST=y
CONFIG_UT_TIME=y
```
